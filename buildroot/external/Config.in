## buildroot/external/Config.in
```kconfig
menu "Raspberry Kitchen Radio packages"

source "$BR2_EXTERNAL_RADIO_PATH/package/go-librespot/Config.in"
source "$BR2_EXTERNAL_RADIO_PATH/package/radio-app/Config.in"

endmenu
```

## buildroot/external/package/go-librespot/Config.in
```kconfig
config BR2_PACKAGE_GO_LIBRESPOT
	bool "go-librespot"
	depends on BR2_PACKAGE_HOST_GO_TARGET_ARCH_SUPPORTS
	depends on BR2_PACKAGE_HOST_GO_TARGET_CGO_LINKING_SUPPORTS
	depends on BR2_TOOLCHAIN_HAS_THREADS
	select BR2_PACKAGE_ALSA_LIB
	select BR2_PACKAGE_LIBVORBIS
	select BR2_PACKAGE_LIBOGG
	help
	  go-librespot is an open-source Spotify Connect client / daemon
	  written in Go. The radio uses its HTTP API + zeroconf discovery.

	  https://github.com/devgianlu/go-librespot

comment "go-librespot needs a toolchain w/ threads, and Go+cgo target support"
	depends on !BR2_PACKAGE_HOST_GO_TARGET_ARCH_SUPPORTS || \
		!BR2_PACKAGE_HOST_GO_TARGET_CGO_LINKING_SUPPORTS || \
		!BR2_TOOLCHAIN_HAS_THREADS
```

## buildroot/external/package/radio-equalizer/Config.in
```kconfig
config BR2_PACKAGE_RADIO_EQUALIZER
	bool "radio-equalizer LADSPA plugin"
	default y
	depends on BR2_PACKAGE_ALSA_LIB
	help
	  Lightweight ten-band biquad parametric equalizer used by the shared
	  ALSA playback route.
```

## buildroot/external/package/radio-swupdate-progress/Config.in
```kconfig
config BR2_PACKAGE_RADIO_SWUPDATE_PROGRESS
	bool "radio SWUpdate progress bridge"
	depends on BR2_PACKAGE_SWUPDATE
	help
	  Installs a small machine-readable client for SWUpdate's binary progress
	  IPC. It is consumed only by the root-owned radio firmware worker.
```
